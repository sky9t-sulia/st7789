## Kconfig.projbuild
```kconfig
menu "ST7789 Configuration"

	config LCD_MOSI_GPIO
		int "MOSI GPIO number"
		default 33
		help
			GPIO number (IOxx) to SPI MOSI.

	config LCD_SCLK_GPIO
		int "SCLK GPIO number"
		default 32
		help
			GPIO number (IOxx) to SPI SCLK.

	config LCD_CS_GPIO
		int "CS GPIO number"
		default 12
		help
			GPIO number (IOxx) to SPI CS.

	config LCD_DC_GPIO
		int "DC GPIO number"
		default 13
		help
			GPIO number (IOxx) to SPI DC.

	config LCD_RESET_GPIO
		int "RESET GPIO number"
		default 14
		help
			GPIO number (IOxx) to RESET.

	config LCD_SPI_FREQUENCY
		int "SPI Frequency (MHZ)"
		range 1 80
		default 20
		help
			SPI Frequency for LCD in MHz.

	config LCD_VER_RES
		int "LCD Vertical Resolution"
		default 240
		help
			LCD Resolution in px

	config LCD_HOR_RES
		int "LCD Horizontal Resolution"
		default 240
		help
			LCD Resolution in px

	choice LCD_SPI_HOST
		prompt "SPI peripheral that controls this bus"
		default LCD_SPI2_HOST
		help
			Select SPI peripheral that controls this bus.
		config LCD_SPI2_HOST
			bool "SPI2_HOST"
			help
				Use SPI2_HOST. This is also called HSPI_HOST.
		config LCD_SPI3_HOST
			depends on IDF_TARGET_ESP32 || IDF_TARGET_ESP32S2 || IDF_TARGET_ESP32S3
			bool "SPI3_HOST"
			help
				USE SPI3_HOST. This is also called VSPI_HOST
	endchoice

	choice LCD_SPI_MODE
		prompt "SPI mode (dio, qio)"
		default LCD_SPI_MODE_QIO
		help
			Select SPI mode. In most cases use QIO. But for some displays only work with dio
		config LCD_SPI_MODE_QIO
			bool "QIO"
		config LCD_SPI_MODE_DIO
			bool "DIO"
	endchoice

endmenu
```
